## config/boards/shields/logitech_comfort/Kconfig.defconfig
```kconfig
if SHIELD_LOGITECH_COMFORT

config ZMK_KEYBOARD_NAME
    default "Bumper Keyboard"

config SPI
    default y

endif
```

## config/boards/shields/logitech_comfort/Kconfig.shield
```kconfig
config SHIELD_LOGITECH_COMFORT
    def_bool $(shields_list_contains,logitech_comfort)
```
